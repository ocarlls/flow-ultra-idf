## main/Kconfig
```kconfig
menu "Flow Mesh Network"

    config FLOW_MESH_MODE
        bool "Habilitar rede mesh (ESP-NOW + LoRa)"
        default n
        help
            Ativa o firmware dedicado de mesh em dois protocolos:
            - ESP-NOW (hidrômetros/METER -> SUBROOT)
            - LoRa (SUBROOT -> ... -> ROOT)

            Observacao: este modo e exclusivo e deve ser usado com
            LORA_TEST_MODE e ESPNOW_TEST_MODE desabilitados.

    choice FLOW_ROLE
        prompt "Papel na rede mesh"
        default FLOW_ROLE_ROOT
        depends on FLOW_MESH_MODE

        config FLOW_ROLE_METER
            bool "METER (ESP32-C6, somente ESP-NOW)"

        config FLOW_ROLE_SUBROOT
            bool "SUBROOT (ESP32-C6 + E220, ESP-NOW + LoRa)"

        config FLOW_ROLE_ROOT
            bool "ROOT (ESP32-C6 + E220, agrega e loga)"
    endchoice

    config FLOW_SUBROOT_SELF_TEST
        bool "SUBROOT: gerar sonda LoRa periodica"
        default n
        depends on FLOW_MESH_MODE && FLOW_ROLE_SUBROOT
        help
            Injeta um pacote sintetico METER_DATA diretamente no enlace LoRa para
            validar a camada SUBROOT -> ROOT sem depender de um METER via ESP-NOW.

    config FLOW_SUBROOT_SELF_TEST_INTERVAL_MS
        int "SUBROOT: intervalo da sonda LoRa (ms)"
        range 1000 60000
        default 5000
        depends on FLOW_SUBROOT_SELF_TEST

    config FLOW_SUBROOT_SELF_TEST_VOLUME_LITERS
        int "SUBROOT: volume fixo da sonda (L)"
        range 1 1000000
        default 4321
        depends on FLOW_SUBROOT_SELF_TEST

    config FLOW_SUBROOT_SELF_TEST_DELTA_LITERS
        int "SUBROOT: delta fixo da sonda (L)"
        range 1 1000000
        default 9
        depends on FLOW_SUBROOT_SELF_TEST

    # -----------------------------------------------------------------------
    # Modo de operacao do METER: relay ESP-NOW em light sleep
    # -----------------------------------------------------------------------
    config FLOW_METER_TX_TEST
        bool "METER: relay ESP-NOW em light sleep (wake-on-radio)"
        default y
        depends on FLOW_MESH_MODE && FLOW_ROLE_METER
        help
            Unico modo do METER: o ESP fica em LIGHT SLEEP com o WiFi ligado e o
            radio em duty-cycle connectionless (wake-on-radio). Ele NAO origina
            dados; dorme ate captar um pacote ESP-NOW numa janela de escuta e,
            ao receber, acorda, faz relay para o proximo node e volta a dormir.
            Nenhum sensor/SPI e inicializado.

            Light sleep real exige CONFIG_PM_ENABLE +
            CONFIG_FREERTOS_USE_TICKLESS_IDLE (caso contrario fica so em
            modem-sleep, com a CPU acordada).

    config FLOW_SUBROOT_LIGHT_SLEEP
        bool "SUBROOT: light sleep + WiFi duty-cycled (RX connectionless)"
        default n
        depends on FLOW_MESH_MODE && FLOW_ROLE_SUBROOT
        help
            Faz o SUBROOT deixar de ser sempre-ligado e dormir em light sleep,
            acordando o WiFi periodicamente (mesma window/interval do METER) para
            receber os bursts ESP-NOW. O lado LoRa permanece (WOR vem na Fase 2).

    config FLOW_LS_WAKE_WINDOW_MS
        int "Light sleep: janela de escuta WiFi (ms)"
        range 5 2000
        default 30
        depends on FLOW_METER_TX_TEST || FLOW_SUBROOT_LIGHT_SLEEP
        help
            Tempo que o radio fica acordado escutando a cada intervalo. Deve ser
            menor que o intervalo. Janela maior = capta mais facil, gasta mais.

    config FLOW_LS_WAKE_INTERVAL_MS
        int "Light sleep: intervalo do duty-cycle WiFi (ms)"
        range 20 4000
        default 300
        depends on FLOW_METER_TX_TEST || FLOW_SUBROOT_LIGHT_SLEEP
        help
            Periodo do duty-cycle do radio. Intervalo maior = menor consumo medio,
            maior latencia de recepcao. METER e SUBROOT devem usar o mesmo par.

    config FLOW_LS_TX_BURST_MS
        int "Light sleep: duracao do burst de TX (ms)"
        range 10 8000
        default 350
        depends on FLOW_METER_TX_TEST
        help
            Repete o mesmo pacote por este tempo (>= 1 intervalo + janela) para
            cair em alguma janela de escuta do receptor, sem sincronia de relogio.

    config FLOW_LS_TX_SPACING_MS
        int "Light sleep: espacamento entre repeticoes do burst (ms)"
        range 1 1000
        default 25
        depends on FLOW_METER_TX_TEST
        help
            Intervalo entre copias dentro do burst. Deve ser <= janela de escuta.

    config FLOW_LS_STATS_INTERVAL_S
        int "Light sleep: intervalo do resumo de estatisticas (s)"
        range 5 600
        default 30
        depends on FLOW_METER_TX_TEST || FLOW_SUBROOT_LIGHT_SLEEP

    config FLOW_LS_VERBOSE
        bool "Light sleep: logs verbosos (desligar para medir corrente limpa)"
        default y
        depends on FLOW_METER_TX_TEST || FLOW_SUBROOT_LIGHT_SLEEP

    # -----------------------------------------------------------------------
    # Protocolo mesh agendado (deep sleep + sync por beacon + descoberta)
    # Ver PROTOCOLO_MESH_AGENDADO.md
    # -----------------------------------------------------------------------
    config FLOW_COLLECT_HOUR
        int "Coleta de dados: hora-base (0-23)"
        range 0 23
        default 16
        depends on FLOW_MESH_MODE

    config FLOW_COLLECT_MIN
        int "Coleta de dados: minuto-base (0-59)"
        range 0 59
        default 30
        depends on FLOW_MESH_MODE

    config FLOW_RESYNC_PERIOD_S
        int "Sync: periodo entre re-sincronizacoes (s)"
        range 10 86400
        default 10800
        depends on FLOW_MESH_MODE
        help
            Sem cristal 32 kHz, re-sincronizar com frequencia (ex.: 3 h) limita a
            deriva do RC. Com cristal, pode subir para 86400 (1x/dia).

    config FLOW_COLLECT_PERIOD_S
        int "Coleta: periodo entre janelas de coleta (s)"
        range 60 86400
        default 86400
        depends on FLOW_MESH_MODE
        help
            Sem RTC/GPS no root, a coleta e periodica a partir do boot do root
            (placeholder). Com RTC, o root ancora em COLLECT_HOUR:COLLECT_MIN e
            este parametro deixa de ser usado. Em bancada use valores curtos
            (ex.: 300 s) para validar o convergecast rapidamente.

    # --- Burst de beacon (redundancia temporal p/ janelas dormentes) ---
    config FLOW_BEACON_BURST_MS
        int "Sync: duracao do burst de beacons na janela de sync (ms)"
        range 1000 60000
        default 10000
        depends on FLOW_MESH_MODE
        help
            O root (e cada subroot ao repassar) repete o beacon durante esta
            janela. Filhos que acordam dentro dela captam alguma copia mesmo
            com erro residual de relogio.

    config FLOW_BEACON_SPACING_MS
        int "Sync: espacamento entre beacons do burst (ms)"
        range 100 5000
        default 500
        depends on FLOW_MESH_MODE
        help
            Airtime do beacon LoRa (42 B) a ~2,4 kbps e ~150-250 ms; 500 ms de
            espacamento deixa folga p/ RX e nao satura o canal.

    config FLOW_DISCOVERY_PERIOD_S
        int "Descoberta: periodo do beacon esparso do root fora do burst (s)"
        range 5 600
        default 30
        depends on FLOW_MESH_MODE
        help
            Fora das janelas de sync o root emite 1 beacon a cada N s para que
            nos em cold boot/SCAN achem a rede em <= N s de escuta e aprendam a
            agenda inteira (o beacon carrega next_sync/next_collect).

    # --- Guarda adaptativa (deriva do RC estimada em tempo de execucao) ---
    config FLOW_GUARD_MIN_MS
        int "Guarda: piso (ms)"
        range 100 60000
        default 2000
        depends on FLOW_MESH_MODE

    config FLOW_GUARD_MAX_MS
        int "Guarda: teto (ms)"
        range 1000 3600000
        default 120000
        depends on FLOW_MESH_MODE

    config FLOW_DRIFT_INIT_PPM
        int "Deriva: incerteza inicial do relogio (ppm)"
        range 100 100000
        default 30000
        depends on FLOW_MESH_MODE
        help
            30000 ppm = 3%, pior caso do RC interno sem calibracao termica.
            Com cristal 32 kHz, reduza para ~200-500 ppm (so Kconfig).

    config FLOW_DRIFT_RESIDUAL_PPM
        int "Deriva: incerteza residual apos convergencia (ppm)"
        range 50 50000
        default 3000
        depends on FLOW_MESH_MODE
        help
            Piso da incerteza (variacao termica entre resyncs). Define a guarda
            de regime: guarda ~= residual_ppm x RESYNC_PERIOD (3000 ppm x 3 h
            ~= 32 s; com cristal cai p/ ~segundos).

    config FLOW_HOP_JITTER_MS
        int "Guarda: margem por salto da cascata (ms)"
        range 0 30000
        default 2000
        depends on FLOW_MESH_MODE
        help
            O burst do pai comeca com atraso variavel (captura + processamento)
            em relacao ao do avo; esta margem por rank cobre esse jitter.

    # --- Recuperacao ---
    config FLOW_SCAN_AFTER_MISSES
        int "Fallback: misses consecutivos ate entrar em SCAN"
        range 1 999
        default 3
        depends on FLOW_MESH_MODE

    config FLOW_SCAN_LISTEN_MS
        int "Fallback/cold boot: duracao da escuta SCAN (ms)"
        range 1000 600000
        default 45000
        depends on FLOW_MESH_MODE
        help
            Deve exceder FLOW_DISCOVERY_PERIOD_S + burst p/ garantir captura.

    config FLOW_REBROADCAST_COPIES
        int "Repasse: copias do beacon/dado por burst de repasse"
        range 1 20
        default 3
        depends on FLOW_MESH_MODE

    config FLOW_REBROADCAST_SPACING_MS
        int "Repasse: espacamento entre copias (ms)"
        range 10 5000
        default 400
        depends on FLOW_MESH_MODE

    # --- Operacao a bateria ---
    config FLOW_SUBROOT_DEEP_SLEEP
        bool "Subroot: deep sleep agendado (producao)"
        default n
        depends on FLOW_MESH_MODE && FLOW_ROLE_SUBROOT
        help
            Subroot dorme entre janelas de sync/coleta (E220 em sleep via
            M0/M1 + hold). Exclui FLOW_SUBROOT_LIGHT_SLEEP/SELF_TEST (bancada).

    config FLOW_STAY_AWAKE_GPIO
        int "Escape hatch: GPIO que segura o no acordado no boot (-1 desliga)"
        range -1 48
        default 9
        depends on FLOW_MESH_MODE
        help
            O USB-JTAG do ESP32-C6 some em deep sleep. Segurando este pino em
            nivel BAIXO durante o boot (GPIO9 = botao BOOT), o no fica acordado
            indefinidamente para regravacao.

    config FLOW_COLLECT_WINDOW_MS
        int "Coleta: duracao da janela de convergecast (ms)"
        range 100 600000
        default 15000
        depends on FLOW_MESH_MODE

    config FLOW_N_RETRIES
        int "Confiabilidade: tentativas por salto"
        range 0 10
        default 3
        depends on FLOW_MESH_MODE

    config FLOW_RETRY_JITTER_MS
        int "Confiabilidade: jitter maximo do backoff (ms)"
        range 0 5000
        default 200
        depends on FLOW_MESH_MODE

    config FLOW_BUFFER_DAYS
        int "Store-and-forward: dias de leitura a reter"
        range 1 30
        default 1
        depends on FLOW_MESH_MODE

    config FLOW_MAX_RETRIES_TOTAL
        int "Store-and-forward: descartar pacote apos N falhas totais"
        range 1 50
        default 5
        depends on FLOW_MESH_MODE

    config FLOW_CRYPTO_ENABLE
        bool "Criptografia AES-GCM do payload (app-layer, ESP-NOW + LoRa)"
        default n
        depends on FLOW_MESH_MODE
        help
            Cifra/autentica o corpo dos quadros na aplicacao (mbedtls), uniforme
            nos dois radios. Requer chave de rede compartilhada.

    config FLOW_CRYPTO_KEY_HEX
        string "Chave de rede AES-128 (32 hex chars = 16 bytes)"
        default "000102030405060708090A0B0C0D0E0F"
        depends on FLOW_CRYPTO_ENABLE

    config FLOW_TEST_ESPNOW_BEACON_ORIGIN
        bool "TESTE: meter atua como origem de BEACON por ESP-NOW (simula root)"
        default n
        depends on FLOW_MESH_MODE && FLOW_ROLE_METER
        help
            Apenas para teste entre meters, SEM root/subroot. O meter fica acordado
            emitindo BEACON (rank 0) por ESP-NOW. Os demais meters (com esta opcao
            DESLIGADA) rodam o ciclo normal e descobrem este como pai. Nunca usar em
            producao (gasta bateria por ficar acordado).

endmenu

menu "EBYTE E220 LoRa Radio"

    comment "Pinos = -1 ate o modulo ser fiado. O driver rejeita pinos invalidos."

    config FLOW_E220_UART_PORT
        int "UART usada pelo E220 (0 = console no ESP32-C6; use 1)"
        range 0 2
        default 1
        help
            Porta UART dedicada ao E220. No ESP32-C6 a UART0 e o console de log,
            entao use UART1.

    config FLOW_E220_PIN_TX
        int "GPIO TX do ESP (-> RXD do E220)"
        range -1 48
        default -1

    config FLOW_E220_PIN_RX
        int "GPIO RX do ESP (<- TXD do E220)"
        range -1 48
        default -1

    config FLOW_E220_PIN_M0
        int "GPIO M0 (saida; bit0 de modo)"
        range -1 48
        default -1

    config FLOW_E220_PIN_M1
        int "GPIO M1 (saida; bit1 de modo)"
        range -1 48
        default -1

    config FLOW_E220_PIN_AUX
        int "GPIO AUX (entrada; busy=0/ready=1)"
        range -1 48
        default -1

    config FLOW_E220_BAUD
        int "Baud da UART (deve casar com o gravado no modulo)"
        range 1200 115200
        default 9600

    config FLOW_E220_ADDRESS
        int "Endereco do modulo (ADDH:ADDL, 0-65535)"
        range 0 65535
        default 0
        help
            Mesmo endereco/canal/air-rate em todos os nos no modo transparente.

    config FLOW_E220_CHANNEL
        int "Canal RF (frequencia = 850.125 + CH MHz)"
        range 0 80
        default 65
        help
            E220-900T22: f = 850.125 MHz + canal x 1 MHz. CH=65 -> ~915 MHz.

    config FLOW_E220_AIR_DATA_RATE
        int "Air data rate (codigo REG0[2:0])"
        range 0 7
        default 2
        help
            Codigo de 3 bits do registrador. Menor taxa = maior alcance. O default
            (2) corresponde a ~2.4 kbps (maior alcance), equivalente a intencao de
            SF alto do driver SPI antigo.

    config FLOW_E220_TX_POWER_DBM
        int "Potencia TX (dBm; arredonda para 22/17/13/10)"
        range 10 22
        default 22

    config FLOW_E220_WOR_PERIOD_MS
        int "Periodo WOR (ms; 0 = WOR desabilitado)"
        range 0 4000
        default 0
        help
            Quando > 0, o modulo entra em wake-on-radio (escuta periodica).
            Passos de 500 ms no E220. 0 mantem o modulo em RX continuo/normal.

    config FLOW_E220_FIXED_MODE
        bool "Modo fixo (endereçado) em vez de transparente"
        default n
        help
            Mantenha desabilitado (transparente) salvo necessidade de endereçamento.

    config FLOW_E220_RSSI_BYTE
        bool "Anexar byte de RSSI ao pacote recebido"
        default y
        help
            Habilita o recurso de RSSI ambiente/por-pacote do E220. O SNR nao esta
            disponivel no modo transparente (renderizado como '--').

endmenu

menu "ESP-NOW Test Module"

    config ESPNOW_TEST_MODE
        bool "Habilitar modo teste dedicado ESP-NOW"
        default n
        help
            Quando habilitado, o firmware ignora o fluxo normal do hidrômetro
            e executa somente o módulo de teste ESP-NOW para validar comunicação
            entre placas.

    choice ESPNOW_TEST_ROLE
        prompt "Papel no teste ESP-NOW"
        default ESPNOW_TEST_ROLE_TX
        depends on ESPNOW_TEST_MODE

        config ESPNOW_TEST_ROLE_TX
            bool "TX (envia ping e espera ACK)"

        config ESPNOW_TEST_ROLE_RX
            bool "RX (recebe ping e responde ACK)"
    endchoice

    config ESPNOW_TEST_CHANNEL
        int "Canal Wi-Fi usado no ESP-NOW"
        range 1 13
        default 1
        depends on ESPNOW_TEST_MODE

    config ESPNOW_TEST_SEND_INTERVAL_MS
        int "Intervalo de envio no TX (ms)"
        range 100 60000
        default 1000
        depends on ESPNOW_TEST_MODE && ESPNOW_TEST_ROLE_TX

    config ESPNOW_TEST_PEER_MAC
        string "MAC do peer (formato AA:BB:CC:DD:EE:FF)"
        default "24:6F:28:00:00:01"
        depends on ESPNOW_TEST_MODE && ESPNOW_TEST_ROLE_TX
        help
            MAC da placa RX que respondera aos pings.

endmenu

menu "LoRa Test Module"

    config LORA_TEST_MODE
        bool "Habilitar modo teste dedicado LoRa"
        default n
        help
            Quando habilitado, o firmware ignora o fluxo normal do hidrômetro
            e executa somente o módulo de teste LoRa para validacao de alcance
            em topologia ROOT/NODE com o modulo EBYTE E220.

    choice LORA_TEST_ROLE
        prompt "Papel no teste LoRa"
        default LORA_TEST_ROLE_ROOT
        depends on LORA_TEST_MODE

        config LORA_TEST_ROLE_ROOT
            bool "ROOT (RX continuo, agrega estatisticas e responde ACK)"

        config LORA_TEST_ROLE_NODE
            bool "NODE (envia PROBE periodico e aguarda ACK)"
    endchoice

    config LORA_TEST_FREQUENCY_MHZ
        int "Frequencia LoRa (MHz)"
        range 137 1020
        default 915
        depends on LORA_TEST_MODE

    config LORA_TEST_NODE_SEND_INTERVAL_MS
        int "Intervalo base de envio do NODE (ms)"
        range 100 600000
        default 2000
        depends on LORA_TEST_MODE && LORA_TEST_ROLE_NODE

    config LORA_TEST_NODE_SEND_JITTER_MS
        int "Jitter aleatorio do NODE (ms)"
        range 0 60000
        default 250
        depends on LORA_TEST_MODE && LORA_TEST_ROLE_NODE
        help
            Offset aleatorio somado/subtraido do intervalo base para reduzir colisao.

    config LORA_TEST_ROOT_SUMMARY_INTERVAL_MS
        int "Intervalo do resumo do ROOT (ms)"
        range 1000 600000
        default 10000
        depends on LORA_TEST_MODE && LORA_TEST_ROLE_ROOT

endmenu
```
