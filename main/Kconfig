## sdkconfig.defaults
```kconfig
# =============================================================================
# Defaults para o TESTE de consumo de transmissao (Fase 1 — light sleep)
# -----------------------------------------------------------------------------
# IMPORTANTE: sdkconfig.defaults so e aplicado quando o sdkconfig e (re)gerado.
# Como ja existe um sdkconfig no repo, para ativar estas opcoes faca UMA destas:
#   - apagar o sdkconfig e rodar `idf.py reconfigure`, ou
#   - habilita-las via `idf.py menuconfig`.
# Estas opcoes so tem efeito no caminho light sleep (gated por Kconfig); o
# baseline deep sleep nao depende delas.
# =============================================================================

# Power management — necessario para esp_pm_configure()
CONFIG_PM_ENABLE=y

# Automatic light sleep — entra em light sleep no idle do FreeRTOS
CONFIG_FREERTOS_USE_TICKLESS_IDLE=y

# Power-save do WiFi no estado desconectado/connectionless — necessario para
# esp_now_set_wake_window() / esp_wifi_connectionless_module_set_wake_interval()
# (no ESP-NOW broadcast nao ha associacao a AP).
CONFIG_ESP_WIFI_STA_DISCONNECTED_PM_ENABLE=y

# Desliga a CPU em light sleep (ja era default no C6), mas NAO desliga
# perifericos — assim UART/console e estado de driver sobrevivem ao sleep.
CONFIG_PM_POWER_DOWN_CPU_IN_LIGHT_SLEEP=y
# CONFIG_PM_POWER_DOWN_PERIPHERAL_IN_LIGHT_SLEEP is not set
```

## sdkconfig.defaults.bench
```kconfig
# =============================================================================
# Parametros de BANCADA — tempos encurtados para validacao rapida do protocolo
# mesh agendado (sync, coleta, deep sleep).
#
# Uso: sobrepor ao sdkconfig.defaults base e ao defaults do role:
#   idf.py -D SDKCONFIG_DEFAULTS="sdkconfig.defaults;sdkconfig.defaults.bench;sdkconfig.defaults.<role>" reconfigure build
# =============================================================================

# Re-sincronizacao a cada 2 min (producao: 3 h / 10800 s)
CONFIG_FLOW_RESYNC_PERIOD_S=120

# Coleta a cada 10 min (producao: 24 h / 86400 s)
CONFIG_FLOW_COLLECT_PERIOD_S=600

# Guarda maxima 30 s (producao: 120 s)
CONFIG_FLOW_GUARD_MAX_MS=30000

# Escuta SCAN 45 s (manter — > discovery period de 30 s)
CONFIG_FLOW_SCAN_LISTEN_MS=45000

# Janela de coleta 15 s (manter)
CONFIG_FLOW_COLLECT_WINDOW_MS=15000

# Burst de beacon 10 s (manter)
CONFIG_FLOW_BEACON_BURST_MS=10000

# Descoberta esparsa a cada 30 s (manter)
CONFIG_FLOW_DISCOVERY_PERIOD_S=30

# Habilitar modo mesh
CONFIG_FLOW_MESH_MODE=y

# Desabilitar deep sleep para teste em bancada (mantem log serial)
CONFIG_FLOW_TEST_NO_SLEEP=y
```

## sdkconfig.defaults.bench-deepsleep
```kconfig
# =============================================================================
# Parametros de BANCADA com DEEP SLEEP habilitado
# Timings maiores que bench normal, mas ainda observaveis em minutos.
#
# Uso: idf.py -D 'SDKCONFIG_DEFAULTS=sdkconfig.defaults;sdkconfig.defaults.bench-deepsleep;sdkconfig.defaults.<role>' reconfigure build
# =============================================================================

# Re-sincronizacao a cada 5 min (producao: 3 h / 10800 s)
CONFIG_FLOW_RESYNC_PERIOD_S=300

# Coleta a cada 15 min (producao: 24 h / 86400 s)
CONFIG_FLOW_COLLECT_PERIOD_S=900

# Guarda maxima 60 s (producao: 120 s)
CONFIG_FLOW_GUARD_MAX_MS=60000

# Escuta SCAN 45 s (manter — > discovery period de 30 s)
CONFIG_FLOW_SCAN_LISTEN_MS=45000

# Janela de coleta 15 s (manter)
CONFIG_FLOW_COLLECT_WINDOW_MS=15000

# Burst de beacon 10 s (manter)
CONFIG_FLOW_BEACON_BURST_MS=10000

# Descoberta esparsa a cada 30 s (manter)
CONFIG_FLOW_DISCOVERY_PERIOD_S=30

# Habilitar modo mesh
CONFIG_FLOW_MESH_MODE=y

# NAO habilitar NO_SLEEP — deep sleep real!
# (removido intencionalmente)
```

## sdkconfig.defaults.meter
```kconfig
# =============================================================================
# Role: METER — somente ESP-NOW, deep sleep agendado, dados sinteticos
# =============================================================================
CONFIG_FLOW_MESH_MODE=y
CONFIG_FLOW_ROLE_METER=y

# IMPORTANTE: desabilitar METER_TX_TEST (default=y) para usar o caminho de
# producao com deep sleep + beacon sync + origem de dados sinteticos.
# Com METER_TX_TEST=y, o meter vira um relay em light sleep (bancada de consumo).
CONFIG_FLOW_METER_TX_TEST=n
```

## sdkconfig.defaults.root
```kconfig
# =============================================================================
# Role: ROOT — sempre ligado, beacon LoRa, agrega e loga
# =============================================================================
CONFIG_FLOW_MESH_MODE=y
CONFIG_FLOW_ROLE_ROOT=y
```

## sdkconfig.defaults.subroot
```kconfig
# =============================================================================
# Role: SUBROOT — ESP-NOW (meters) + LoRa (root), deep sleep agendado
# =============================================================================
CONFIG_FLOW_MESH_MODE=y
CONFIG_FLOW_ROLE_SUBROOT=y
CONFIG_FLOW_SUBROOT_DEEP_SLEEP=y
```
